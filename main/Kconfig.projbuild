## main/Kconfig.projbuild
```kconfig
menu "Example Configuration"
    config CONFIG_LED_RMT_TX_GPIO
        int "RMT TX GPIO"
        default 27
        help
            Set the GPIO number used for transmitting the RMT LED signal.

endmenu
```
